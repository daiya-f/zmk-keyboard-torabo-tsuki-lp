/*
 * 4方向スイッチ用レイアウト定義だけを取り込むスニペット。
 * 4方向スイッチを付けていない側（セントラル）で使う。
 *
 * キーマップ配列の長さは有効な physical-layout の最大キー数で決まるため、
 * スイッチ側と同じ71キーのレイアウトをセントラル側にも定義しておかないと
 * キーマップの後ろ5キーが範囲外になる。
 * 一方でスイッチ本体の kscan1 は定義しないので、トラックボール／
 * トラックパッドが使うピン（P0.16 / P0.18 / P0.19 / P0.20）とは衝突しない。
 */

#include "../kscan-4-direction-switch/kscan-4-direction-switch-layouts.dtsi"

/{
    chosen {
        zmk,physical-layout = &physical_layout_l_4_direction;
        zmk,kscan = &kscan2;
    };

    kscan2: kscan2 {
        compatible = "zmk,kscan-composite";
        rows = <6>;
        columns = <7>;

        matrix {
            kscan = <&kscan0>;
#if defined(TORABO_TSUKI_LP_RIGHT)
            col-offset = <7>;
#endif
        };
    };
};
